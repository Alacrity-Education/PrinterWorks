/* anim.c — v2.1 production animation engine (2026-09-06).
 *
 * Ported from ../../anim.c with, vs the original:
 *   1. single gamma curve (see gamma_lut; the LUT itself is the ported
 *      placeholder — gamma 2.2 active, other curves commented out);
 *   2. modes 0x04-0x09 (spin/rain/draw presets) REMOVED from the chip —
 *      owner decision: the HOST expands them into mode-0x03 sequences
 *      (exact nibble sequences in docs/ANIMATION_PROTOCOL.md).  fill_seq_data and the
 *      six preset tables are gone;
 *   3. anim_sequence's three near-duplicate fade branches folded into
 *      one parameterised path (seq_put / seq_edge) — feature-preserving,
 *      proven byte-identical to the original on the host
 *      (recon/approaches/dev_prod/anim_eq/);
 *   4. the flags are read in place (const pointer into the decoded
 *      frame) instead of a 24-byte stack copy: nothing mutates them any
 *      more (fill_seq_data was the only writer).  The decoded frame must
 *      not change during anim_render — true in the production main loop
 *      (decode and render are sequential, never concurrent).
 *
 * Depends on millis() and the 48-byte decoded frame; the millis/TIM4
 * tick must be provided by the new firmware (old provider ws2812_in.c).
 */
#include "anim.h"
#include "ws2812_in.h"
#include "ws2812_out.h"

/* Gamma LUT: 4 curves (1.8, 2.2, 2.5, 2.8) x 256 entries, stored in flash */
/* Gamma LUT — SINGLE curve (v2.1 port, saves 768 B flash vs 4 curves).
 * Active curve: gamma 2.2 (PLACEHOLDER — final curve TBD by owner).
 * The three removed curves are preserved in comments below the table.
 */
static const uint8_t gamma_lut[256] = {
    /* gamma 2.2 (ACTIVE) */
    0x00, 0x00, 0x00, 0x00, 0x00, 0x00, 0x00, 0x00, 0x00, 0x00, 0x00, 0x00, 0x00, 0x00, 0x00, 0x01,
    0x01, 0x01, 0x01, 0x01, 0x01, 0x01, 0x01, 0x01, 0x01, 0x02, 0x02, 0x02, 0x02, 0x02, 0x02, 0x02,
    0x03, 0x03, 0x03, 0x03, 0x03, 0x04, 0x04, 0x04, 0x04, 0x05, 0x05, 0x05, 0x05, 0x06, 0x06, 0x06,
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    0xDF, 0xE1, 0xE3, 0xE5, 0xE7, 0xEA, 0xEC, 0xEE, 0xF0, 0xF2, 0xF4, 0xF6, 0xF8, 0xFB, 0xFD, 0xFF,
};

/* gamma 1.8 — removed from the build (single-curve port);
   kept for the final curve selection. To swap: replace the
   active table below with this data.
    0x00, 0x00, 0x00, 0x00, 0x00, 0x00, 0x00, 0x00, 0x01, 0x01, 0x01, 0x01, 0x01, 0x01, 0x01, 0x02,
    0x02, 0x02, 0x02, 0x02, 0x03, 0x03, 0x03, 0x03, 0x04, 0x04, 0x04, 0x04, 0x05, 0x05, 0x05, 0x06,
    0x06, 0x06, 0x07, 0x07, 0x08, 0x08, 0x08, 0x09, 0x09, 0x0A, 0x0A, 0x0A, 0x0B, 0x0B, 0x0C, 0x0C,
    0x0D, 0x0D, 0x0E, 0x0E, 0x0F, 0x0F, 0x10, 0x10, 0x11, 0x11, 0x12, 0x12, 0x13, 0x13, 0x14, 0x15,
    0x15, 0x16, 0x16, 0x17, 0x18, 0x18, 0x19, 0x1A, 0x1A, 0x1B, 0x1C, 0x1C, 0x1D, 0x1E, 0x1E, 0x1F,
    0x20, 0x20, 0x21, 0x22, 0x23, 0x23, 0x24, 0x25, 0x26, 0x26, 0x27, 0x28, 0x29, 0x29, 0x2A, 0x2B,
    0x2C, 0x2D, 0x2E, 0x2E, 0x2F, 0x30, 0x31, 0x32, 0x33, 0x34, 0x35, 0x35, 0x36, 0x37, 0x38, 0x39,
    0x3A, 0x3B, 0x3C, 0x3D, 0x3E, 0x3F, 0x40, 0x41, 0x42, 0x43, 0x44, 0x45, 0x46, 0x47, 0x48, 0x49,
    0x4A, 0x4B, 0x4C, 0x4D, 0x4E, 0x4F, 0x50, 0x51, 0x52, 0x53, 0x54, 0x56, 0x57, 0x58, 0x59, 0x5A,
    0x5B, 0x5C, 0x5D, 0x5F, 0x60, 0x61, 0x62, 0x63, 0x64, 0x66, 0x67, 0x68, 0x69, 0x6B, 0x6C, 0x6D,
    0x6E, 0x6F, 0x71, 0x72, 0x73, 0x74, 0x76, 0x77, 0x78, 0x7A, 0x7B, 0x7C, 0x7E, 0x7F, 0x80, 0x81,
    0x83, 0x84, 0x86, 0x87, 0x88, 0x8A, 0x8B, 0x8C, 0x8E, 0x8F, 0x91, 0x92, 0x93, 0x95, 0x96, 0x98,
    0x99, 0x9A, 0x9C, 0x9D, 0x9F, 0xA0, 0xA2, 0xA3, 0xA5, 0xA6, 0xA8, 0xA9, 0xAB, 0xAC, 0xAE, 0xAF,
    0xB1, 0xB2, 0xB4, 0xB5, 0xB7, 0xB8, 0xBA, 0xBC, 0xBD, 0xBF, 0xC0, 0xC2, 0xC3, 0xC5, 0xC7, 0xC8,
    0xCA, 0xCC, 0xCD, 0xCF, 0xD0, 0xD2, 0xD4, 0xD5, 0xD7, 0xD9, 0xDA, 0xDC, 0xDE, 0xE0, 0xE1, 0xE3,
    0xE5, 0xE6, 0xE8, 0xEA, 0xEC, 0xED, 0xEF, 0xF1, 0xF3, 0xF4, 0xF6, 0xF8, 0xFA, 0xFB, 0xFD, 0xFF,
*/

/* gamma 2.5 — removed from the build (single-curve port);
   kept for the final curve selection. To swap: replace the
   active table below with this data.
    0x00, 0x00, 0x00, 0x00, 0x00, 0x00, 0x00, 0x00, 0x00, 0x00, 0x00, 0x00, 0x00, 0x00, 0x00, 0x00,
    0x00, 0x00, 0x00, 0x00, 0x00, 0x00, 0x01, 0x01, 0x01, 0x01, 0x01, 0x01, 0x01, 0x01, 0x01, 0x01,
    0x01, 0x02, 0x02, 0x02, 0x02, 0x02, 0x02, 0x02, 0x02, 0x03, 0x03, 0x03, 0x03, 0x03, 0x04, 0x04,
    0x04, 0x04, 0x04, 0x05, 0x05, 0x05, 0x05, 0x06, 0x06, 0x06, 0x06, 0x07, 0x07, 0x07, 0x07, 0x08,
    0x08, 0x08, 0x09, 0x09, 0x09, 0x0A, 0x0A, 0x0A, 0x0B, 0x0B, 0x0C, 0x0C, 0x0C, 0x0D, 0x0D, 0x0E,
    0x0E, 0x0F, 0x0F, 0x0F, 0x10, 0x10, 0x11, 0x11, 0x12, 0x12, 0x13, 0x13, 0x14, 0x14, 0x15, 0x16,
    0x16, 0x17, 0x17, 0x18, 0x19, 0x19, 0x1A, 0x1A, 0x1B, 0x1C, 0x1C, 0x1D, 0x1E, 0x1E, 0x1F, 0x20,
    0x21, 0x21, 0x22, 0x23, 0x24, 0x24, 0x25, 0x26, 0x27, 0x28, 0x28, 0x29, 0x2A, 0x2B, 0x2C, 0x2D,
    0x2E, 0x2E, 0x2F, 0x30, 0x31, 0x32, 0x33, 0x34, 0x35, 0x36, 0x37, 0x38, 0x39, 0x3A, 0x3B, 0x3C,
    0x3D, 0x3E, 0x3F, 0x40, 0x41, 0x43, 0x44, 0x45, 0x46, 0x47, 0x48, 0x49, 0x4B, 0x4C, 0x4D, 0x4E,
    0x50, 0x51, 0x52, 0x53, 0x55, 0x56, 0x57, 0x59, 0x5A, 0x5B, 0x5D, 0x5E, 0x5F, 0x61, 0x62, 0x63,
    0x65, 0x66, 0x68, 0x69, 0x6B, 0x6C, 0x6E, 0x6F, 0x71, 0x72, 0x74, 0x75, 0x77, 0x79, 0x7A, 0x7C,
    0x7D, 0x7F, 0x81, 0x82, 0x84, 0x86, 0x87, 0x89, 0x8B, 0x8D, 0x8E, 0x90, 0x92, 0x94, 0x96, 0x97,
    0x99, 0x9B, 0x9D, 0x9F, 0xA1, 0xA3, 0xA5, 0xA6, 0xA8, 0xAA, 0xAC, 0xAE, 0xB0, 0xB2, 0xB4, 0xB6,
    0xB8, 0xBA, 0xBD, 0xBF, 0xC1, 0xC3, 0xC5, 0xC7, 0xC9, 0xCC, 0xCE, 0xD0, 0xD2, 0xD4, 0xD7, 0xD9,
    0xDB, 0xDD, 0xE0, 0xE2, 0xE4, 0xE7, 0xE9, 0xEB, 0xEE, 0xF0, 0xF3, 0xF5, 0xF8, 0xFA, 0xFD, 0xFF,
*/

/* gamma 2.8 — removed from the build (single-curve port);
   kept for the final curve selection. To swap: replace the
   active table below with this data.
    0x00, 0x00, 0x00, 0x00, 0x00, 0x00, 0x00, 0x00, 0x00, 0x00, 0x00, 0x00, 0x00, 0x00, 0x00, 0x00,
    0x00, 0x00, 0x00, 0x00, 0x00, 0x00, 0x00, 0x00, 0x00, 0x00, 0x00, 0x00, 0x01, 0x01, 0x01, 0x01,
    0x01, 0x01, 0x01, 0x01, 0x01, 0x01, 0x01, 0x01, 0x01, 0x02, 0x02, 0x02, 0x02, 0x02, 0x02, 0x02,
    0x02, 0x03, 0x03, 0x03, 0x03, 0x03, 0x03, 0x03, 0x04, 0x04, 0x04, 0x04, 0x04, 0x05, 0x05, 0x05,
    0x05, 0x06, 0x06, 0x06, 0x06, 0x07, 0x07, 0x07, 0x07, 0x08, 0x08, 0x08, 0x09, 0x09, 0x09, 0x0A,
    0x0A, 0x0A, 0x0B, 0x0B, 0x0B, 0x0C, 0x0C, 0x0D, 0x0D, 0x0D, 0x0E, 0x0E, 0x0F, 0x0F, 0x10, 0x10,
    0x11, 0x11, 0x12, 0x12, 0x13, 0x13, 0x14, 0x14, 0x15, 0x15, 0x16, 0x16, 0x17, 0x18, 0x18, 0x19,
    0x19, 0x1A, 0x1B, 0x1B, 0x1C, 0x1D, 0x1D, 0x1E, 0x1F, 0x20, 0x20, 0x21, 0x22, 0x23, 0x23, 0x24,
    0x25, 0x26, 0x27, 0x27, 0x28, 0x29, 0x2A, 0x2B, 0x2C, 0x2D, 0x2E, 0x2F, 0x30, 0x31, 0x32, 0x32,
    0x33, 0x34, 0x36, 0x37, 0x38, 0x39, 0x3A, 0x3B, 0x3C, 0x3D, 0x3E, 0x3F, 0x40, 0x42, 0x43, 0x44,
    0x45, 0x46, 0x48, 0x49, 0x4A, 0x4B, 0x4D, 0x4E, 0x4F, 0x51, 0x52, 0x53, 0x55, 0x56, 0x57, 0x59,
    0x5A, 0x5C, 0x5D, 0x5F, 0x60, 0x62, 0x63, 0x65, 0x66, 0x68, 0x69, 0x6B, 0x6D, 0x6E, 0x70, 0x72,
    0x73, 0x75, 0x77, 0x78, 0x7A, 0x7C, 0x7E, 0x7F, 0x81, 0x83, 0x85, 0x87, 0x89, 0x8A, 0x8C, 0x8E,
    0x90, 0x92, 0x94, 0x96, 0x98, 0x9A, 0x9C, 0x9E, 0xA0, 0xA2, 0xA4, 0xA7, 0xA9, 0xAB, 0xAD, 0xAF,
    0xB1, 0xB4, 0xB6, 0xB8, 0xBA, 0xBD, 0xBF, 0xC1, 0xC4, 0xC6, 0xC8, 0xCB, 0xCD, 0xD0, 0xD2, 0xD5,
    0xD7, 0xDA, 0xDC, 0xDF, 0xE1, 0xE4, 0xE7, 0xE9, 0xEC, 0xEF, 0xF1, 0xF4, 0xF7, 0xF9, 0xFC, 0xFF
*/


/* Preset auto-fill tables (modes 0x04-0x09) removed: host-side expansion
 * (docs/ANIMATION_PROTOCOL.md "Animation Modes").  The nibble sequences the host must
 * send as mode 0x03 are, byte-exact:
 *   0x04 spin      01 57 62 FF     0x05 spin rev  26 75 10 FF
 *   0x06 rain      34 01 57 62 FF  0x07 rain rev  26 75 10 43 FF
 *   0x08 draw      01 23 45 67 FF  0x09 draw rev  76 54 32 10 FF
 */

/* lerp blend position: set once per render path, read by every lerp()
 * call -- SDCC passes fewer arguments this way (measurable flash win) */
static uint8_t lp_m, lp_z;

static uint8_t lerp(uint8_t x1, uint8_t x2)
{
    if (lp_z == 0) return x2;
    return (uint8_t)(((uint16_t)x1 * lp_m + (uint16_t)x2 * (lp_z - lp_m))
                     / lp_z);
}

static uint8_t get_seq_nib(const uint8_t *f, uint8_t idx)
{
    uint8_t v = f[7 + (idx >> 1)];
    return (idx & 1) ? (v & 0x0F) : (v >> 4);
}

static uint8_t count_seq_len(const uint8_t *f)
{
    uint8_t len = 0;
    for (uint8_t i = 0; i < 32; i++) {
        if (get_seq_nib(f, i) > 8) break;
        len++;
    }
    return len;
}

static void scale_phase(uint16_t phase, uint16_t dur, uint8_t *m, uint8_t *z)
{
    while (dur > 255) { dur >>= 1; phase >>= 1; }
    *z = dur ? (uint8_t)dur : 1;
    *m = (uint8_t)phase;
    if (*m > *z) *m = *z;
}

/* Write one LED's GRB triple into the output buffer.  If this LED was
 * already written by an earlier sequence role this frame (bit set in
 * `written`), the values are summed and clamped to 255 instead —
 * identical to the original's add_clamp-on-collision behaviour.
 * Returns the updated written mask. */
static uint8_t seq_put(uint8_t led, const uint8_t *v, uint8_t written)
{
    uint8_t *p = ws2812_out_buf + led * 3;
    uint8_t bit = (uint8_t)(1 << led);
    if (written & bit) {
        for (uint8_t c = 0; c < 3; c++) {
            uint16_t s = (uint16_t)p[c] + v[c];
            p[c] = s > 255 ? 255 : (uint8_t)s;
        }
    } else {
        p[0] = v[0]; p[1] = v[1]; p[2] = v[2];
    }
    return (uint8_t)(written | bit);
}

/* Fading edge of the sequence: dir=0 = previous step fading out
 * (base at m=0 -> bg at m=z), dir=1 = next step fading in
 * (bg at m=0 -> base at m=z).  Sum+clamp on collision via seq_put. */
static uint8_t seq_edge(const uint8_t *base, const uint8_t *bg, uint8_t led,
                        uint8_t dir, uint8_t written)
{
    uint8_t v[3];
    const uint8_t *b = base + led * 3;
    for (uint8_t c = 0; c < 3; c++)
        v[c] = dir ? lerp(b[c], bg[c]) : lerp(bg[c], b[c]);
    return seq_put(led, v, written);
}

static void anim_none(const uint8_t *base)
{
    uint8_t *d = ws2812_out_buf;
    for (uint8_t i = 0; i < WS2812_OUT_BUF_SIZE; i++)
        *d++ = *base++;
}

static void apply_mask(const uint8_t *f)
{
    uint8_t mask = f[2];
    uint8_t *p = ws2812_out_buf;
    if (!mask) return;
    for (uint8_t bit = 0x80; bit; bit >>= 1, p += 3) {
        if (mask & bit) {
            p[0] = f[6];
            p[1] = f[7];
            p[2] = f[8];
        }
    }
}

/* Shared blend loop for blink and fade: every LED byte becomes
 * lerp(alt, base, m, z), then the mask overlay.  Blink is the m=z
 * (pure alt) / m=0 (pure base) special case with z=1 -- exact through
 * integer lerp: lerp(a,b,0,1) = b, lerp(a,b,1,1) = a, no rounding. */
static void anim_blend(const uint8_t *base, const uint8_t *f)
{
    const uint8_t *alt = f + 3;
    uint8_t c = 0;
    for (uint8_t i = 0; i < WS2812_OUT_BUF_SIZE; i++) {
        ws2812_out_buf[i] = lerp(alt[c], base[i]);
        if (++c == 3) c = 0;
    }
    apply_mask(f);
}

static void anim_blink(uint16_t now_ms, const uint8_t *base, const uint8_t *f)
{
    uint16_t cycle = (uint16_t)f[1] * 50;
    if (cycle == 0) { anim_none(base); return; }
    lp_m = ((now_ms % cycle) < (cycle >> 1)) ? 0 : 1;
    lp_z = 1;
    anim_blend(base, f);
}

static void anim_fade(uint16_t now_ms, const uint8_t *base, const uint8_t *f)
{
    uint16_t cycle = (uint16_t)f[1] * 50;
    if (cycle == 0) { anim_none(base); return; }
    uint16_t half = cycle >> 1;
    if (half == 0) half = 1;
    uint16_t elapsed = now_ms % cycle;
    uint16_t phase = (elapsed < half) ? elapsed : (cycle - elapsed);

    scale_phase(phase, half, &lp_m, &lp_z);
    anim_blend(base, f);
}

static void anim_sequence(uint16_t now_ms, const uint8_t *base, const uint8_t *f)
{
    if (f[1] == 0) { anim_none(base); return; }

    uint8_t seq_len = count_seq_len(f);
    if (seq_len == 0) { anim_none(base); return; }

    uint8_t mask     = f[2];
    uint8_t features = f[6];
    uint8_t bg[3]    = {f[3], f[4], f[5]};

    uint16_t cycle_cs = (uint16_t)f[1] * 5;
    uint16_t elapsed_cs = (now_ms / 10) % cycle_cs;

    uint16_t step_dur = cycle_cs / seq_len;
    if (step_dur == 0) step_dur = 1;
    uint8_t step = (uint8_t)(elapsed_cs / step_dur);
    if (step >= seq_len) step = seq_len - 1;
    uint16_t phase = elapsed_cs - (uint16_t)step * step_dur;

    scale_phase(phase, step_dur, &lp_m, &lp_z);

    uint8_t gsz = 1;
    if (features & 8)      gsz = 4;
    else if (features & 4) gsz = 2;

    /* fill background */
    {
        uint8_t *p = ws2812_out_buf;
        uint8_t c = 0;
        for (uint8_t i = 0; i < WS2812_OUT_BUF_SIZE; i++) {
            *p++ = bg[c];
            if (++c == 3) c = 0;
        }
    }

    /* One parameterised path replaces the original's three near-duplicate
     * branches.  fade  = any fading (feature bits 0|1);
     *            fade3 = 3-LED fading (bit 0, priority over bit 1).
     *   current group: solid base (3-LED fading and no-fading) or fading
     *                  in from bg (2-LED fading); plain overwrite, no
     *                  collision sum — exactly the original group loops;
     *   prev (fading only): fades out, collision-summed;
     *   next (3-LED only):  fades in,  collision-summed. */
    {
        uint8_t fade  = (uint8_t)(features & 3);
        uint8_t fade3 = (uint8_t)(features & 1);
        uint8_t written = 0;

        for (uint8_t g = 0; g < gsz; g++) {
            uint8_t led = get_seq_nib(f, (uint8_t)((step + g) % seq_len));
            if (led < 8) {
                uint8_t *p = ws2812_out_buf + led * 3;
                const uint8_t *b = base + led * 3;
                if (fade3 || !fade) {
                    p[0] = b[0]; p[1] = b[1]; p[2] = b[2];
                } else {
                    p[0] = lerp(b[0], bg[0]);
                    p[1] = lerp(b[1], bg[1]);
                    p[2] = lerp(b[2], bg[2]);
                }
                written |= (uint8_t)(1 << led);
            }
        }

        if (fade) {
            uint8_t led = get_seq_nib(f,
                              (uint8_t)((step + seq_len - 1) % seq_len));
            if (led < 8)
                written = seq_edge(base, bg, led, 0, written);
            if (fade3) {
                led = get_seq_nib(f, (uint8_t)((step + gsz) % seq_len));
                if (led < 8)
                    seq_edge(base, bg, led, 1, written);
            }
        }
    }

    /* masked LEDs always show base color */
    {
        uint8_t *p = ws2812_out_buf;
        for (uint8_t bit = 0x80; bit; bit >>= 1, p += 3, base += 3) {
            if (mask & bit) {
                p[0] = base[0];
                p[1] = base[1];
                p[2] = base[2];
            }
        }
    }
}

static void apply_gamma(uint8_t cfg)
{
    /* Single-curve build: flags[23] values 1..4 all select the one
     * compiled-in curve (0 = off, as before). The per-value curve
     * selection returns if/when multiple tables are compiled in. */
    if (cfg == 0 || cfg > 4) return;
    for (uint8_t i = 0; i < WS2812_OUT_BUF_SIZE; i++)
        ws2812_out_buf[i] = gamma_lut[ws2812_out_buf[i]];
}

void anim_render(uint16_t now_ms)
{
    uint8_t base[24];
    /* flags read in place: nothing mutates them (fill_seq_data is gone)
     * and the decoded frame is stable for the whole render (main-loop
     * architecture: decode never runs concurrently with a render). */
    const uint8_t *f = (const uint8_t *)ws2812_in_buf + 24;
    uint8_t mode;

    {
        const uint8_t *src = ws2812_in_buf + 21;   /* LED 7 */
        uint8_t *dst = base;
        for (uint8_t i = 0; i < 8; i++) {
            dst[0] = src[0];
            dst[1] = src[1];
            dst[2] = src[2];
            dst += 3;
            src -= 3;
        }
    }

    /* modes 0x04-0x09 are host-expanded into 0x03 (owner decision) and
     * fall to anim_none here like any other unknown mode */
    mode = f[0];
    if      (mode == 0x01) anim_blink(now_ms, base, f);
    else if (mode == 0x02) anim_fade(now_ms, base, f);
    else if (mode == 0x03) anim_sequence(now_ms, base, f);
    else                   anim_none(base);

    apply_gamma(f[23]);

    {
        uint8_t *lo = ws2812_out_buf;
        uint8_t *hi = ws2812_out_buf + 21;
        for (uint8_t i = 0; i < 4; i++) {
            for (uint8_t c = 0; c < 3; c++) {
                uint8_t tmp = lo[c];
                lo[c] = hi[c];
                hi[c] = tmp;
            }
            lo += 3;
            hi -= 3;
        }
    }
}
